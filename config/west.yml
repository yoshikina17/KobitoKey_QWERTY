## config/west.yml
```yaml
manifest:
  defaults:
    revision: v0.3
  remotes:
    - name: zmkfirmware
      url-base: https://github.com/zmkfirmware
    - name: badjeff
      url-base: https://github.com/badjeff

  projects:
    # ZMK 本体。公式の app/west.yml を取り込む
    - name: zmk
      remote: zmkfirmware
      import: app/west.yml

    # PMW3610 ドライバ（外部モジュール）
    - name: zmk-pmw3610-driver
      remote: badjeff
      revision: main
      # 置き場所を明示したい場合は path を指定（任意）
      # path: modules/zmk-pmw3610-driver

  self:
    path: configr
```
